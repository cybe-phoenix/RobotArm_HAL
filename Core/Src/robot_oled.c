#include "robot_oled.h"
#include "i2c.h"
#include "robot_oled_font.h"
#include "stdio.h"
#include "string.h"

const uint8_t OLED_F6x8[][6] =
{
    {0x00,0x00,0x00,0x00,0x00,0x00}, // space
    {0x00,0x00,0x5F,0x00,0x00,0x00}, // !
    {0x00,0x07,0x00,0x07,0x00,0x00}, // "
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    {0x08,0x08,0x2A,0x1C,0x08,0x00}  // ->
};

/* SSD1306 常用地址：0x3C 左移 1 位 */
#define OLED_I2C_ADDR   (0x3C << 1)

#define OLED_CMD        0x00
#define OLED_DATA       0x40

static void OLED_Write_Command(uint8_t cmd)
{
    uint8_t data[2];

    data[0] = OLED_CMD;
    data[1] = cmd;

    HAL_I2C_Master_Transmit(&hi2c2, OLED_I2C_ADDR, data, 2, 100);
}

static void OLED_Write_Data(uint8_t data_byte)
{
    uint8_t data[2];

    data[0] = OLED_DATA;
    data[1] = data_byte;

    HAL_I2C_Master_Transmit(&hi2c2, OLED_I2C_ADDR, data, 2, 100);
}

static void OLED_Set_Pos(uint8_t x, uint8_t page)
{
    OLED_Write_Command(0xB0 + page);                         // 设置页地址
    OLED_Write_Command(((x & 0xF0) >> 4) | 0x10);             // 设置列地址高 4 位
    OLED_Write_Command((x & 0x0F) | 0x00);                    // 设置列地址低 4 位
}

static void OLED_Clear(void)
{
    uint8_t page;
    uint8_t x;

    for (page = 0; page < 8; page++)
    {
        OLED_Set_Pos(0, page);

        for (x = 0; x < 128; x++)
        {
            OLED_Write_Data(0x00);
        }
    }
}

static void OLED_ShowChar(uint8_t x, uint8_t page, char chr)
{
    uint8_t i;
    uint8_t index;

    if (chr < 0x20 || chr > 0x7E)
    {
        chr = ' ';
    }

    index = chr - 0x20;

    OLED_Set_Pos(x, page);

    for (i = 0; i < 6; i++)
    {
        OLED_Write_Data(OLED_F6x8[index][i]);
    }
}

static void OLED_ShowString(uint8_t x, uint8_t page, const char *str)
{
    while (*str != '\0')
    {
        OLED_ShowChar(x, page, *str);
        x += 6;

        if (x > 122)
        {
            x = 0;
            page++;

            if (page >= 8)
            {
                break;
            }
        }

        str++;
    }
}

#define OLED_LINE_CHARS  21

static void OLED_ShowLine(uint8_t page, const char *str)
{
    char line[OLED_LINE_CHARS + 1];
    uint8_t i;

    for (i = 0; i < OLED_LINE_CHARS; i++)
    {
        line[i] = ' ';
    }

    line[OLED_LINE_CHARS] = '\0';

    i = 0;
    while (str[i] != '\0' && i < OLED_LINE_CHARS)
    {
        line[i] = str[i];
        i++;
    }

    OLED_ShowString(0, page, line);
}

void Robot_OLED_Init(void)
{
    HAL_Delay(100);

    OLED_Write_Command(0xAE);
    OLED_Write_Command(0x20);
    OLED_Write_Command(0x10);
    OLED_Write_Command(0xB0);
    OLED_Write_Command(0xC8);
    OLED_Write_Command(0x00);
    OLED_Write_Command(0x10);
    OLED_Write_Command(0x40);
    OLED_Write_Command(0x81);
    OLED_Write_Command(0x7F);
    OLED_Write_Command(0xA1);
    OLED_Write_Command(0xA6);
    OLED_Write_Command(0xA8);
    OLED_Write_Command(0x3F);
    OLED_Write_Command(0xA4);
    OLED_Write_Command(0xD3);
    OLED_Write_Command(0x00);
    OLED_Write_Command(0xD5);
    OLED_Write_Command(0x80);
    OLED_Write_Command(0xD9);
    OLED_Write_Command(0xF1);
    OLED_Write_Command(0xDA);
    OLED_Write_Command(0x12);
    OLED_Write_Command(0xDB);
    OLED_Write_Command(0x40);
    OLED_Write_Command(0x8D);
    OLED_Write_Command(0x14);
    OLED_Write_Command(0xAF);

    OLED_Clear();
}

void Robot_OLED_Update(uint8_t key,
                       uint8_t gripper_state,
                       uint8_t playback_busy,
                       uint16_t record_count)
{
    char line[22];

    (void)key;

    OLED_ShowLine(0, "Robot Arm");

    if (playback_busy)
    {
        OLED_ShowLine(2, "Mode: Playback");
    }
    else
    {
        OLED_ShowLine(2, "Mode: Manual");
    }

    sprintf(line, "Points: %03d", record_count);
    OLED_ShowLine(4, line);

    if (gripper_state == 0)
    {
        OLED_ShowLine(6, "Grip: Open");
    }
    else
    {
        OLED_ShowLine(6, "Grip: Close");
    }
}
